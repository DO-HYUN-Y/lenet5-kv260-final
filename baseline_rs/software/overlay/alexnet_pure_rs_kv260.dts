/dts-v1/;
/plugin/;

/ {
    fragment@0 {
        target = <&fpga_full>;
        __overlay__ {
            firmware-name = "alexnet_pure_rs_kv260.bit.bin";
        };
    };

    fragment@1 {
        target = <&amba>;
        __overlay__ {
            #address-cells = <2>;
            #size-cells = <2>;

            alexnet_board: alexnet@a0000000 {
                compatible = "yun,alexnet-kv260-board-1.0";
                status = "okay";

                reg = <0x0 0xa0000000 0x0 0x00010000>,
                      <0x0 0xa0010000 0x0 0x00010000>,
                      <0x0 0xa0020000 0x0 0x00010000>;
                reg-names = "accelerator", "main-dma", "camera-dma";

                clocks = <&zynqmp_clk 71>;
                clock-names = "pl_clk0";
                yun,fabric-clock-hz = <199998002>;
            };
        };
    };
};
